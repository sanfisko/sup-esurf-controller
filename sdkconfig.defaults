## sdkconfig.defaults
```kconfig
# Bluetooth конфигурация
CONFIG_BT_ENABLED=y
CONFIG_BT_CLASSIC_ENABLED=y
CONFIG_BT_CONTROLLER_ENABLED=y
CONFIG_BT_BLUEDROID_ENABLED=y

# Режим контроллера - только Classic BT для HID Host
# CONFIG_BTDM_CTRL_MODE_BTDM=y
# CONFIG_BTDM_CTRL_MODE_BLE_ONLY=n
CONFIG_BTDM_CTRL_MODE_BR_EDR_ONLY=y

# Отключить BLE для экономии памяти
CONFIG_BT_BLE_ENABLED=n

# Настройки для HID Host
CONFIG_BT_HID_HOST_ENABLED=y
CONFIG_BT_HID_ENABLED=y

# Настройки памяти
CONFIG_BT_ALLOCATION_FROM_SPIRAM_FIRST=y
# CONFIG_BT_BLE_DYNAMIC_ENV_MEMORY=y  # Отключено, так как BLE не используется

# Логирование
CONFIG_LOG_DEFAULT_LEVEL_INFO=y
CONFIG_LOG_DEFAULT_LEVEL=3

# Настройки GPIO
CONFIG_GPIO_ESP32_SUPPORT_SWITCH_SLP_PULL=y

# Настройки LEDC (опция LEDC_USE_XTAL_CLK устарела в ESP-IDF v5.4+)
# CONFIG_LEDC_USE_XTAL_CLK=y
```
